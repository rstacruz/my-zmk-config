#define LAYOUT36( \
	a0, a1, a2, a3, a4, /**/ a5, a6, a7, a8, a9, \
	b0, b1, b2, b3, b4, /**/ b5, b6, b7, b8, b9, \
	c0, c1, c2, c3, c4, /**/ c5, c6, c7, c8, c9, \
	/*   */ d2, d3, d4, /**/ d5, d6, d7 \
	) \
	a0 a1 a2 a3 a4 &none &none a5 a6 a7 a8 a9 \
	b0 b1 b2 b3 b4 &none &none b5 b6 b7 b8 b9 \
	c0 c1 c2 c3 c4 &none &none c5 c6 c7 c8 c9 \
	      d2 d3 d4 d4    d5    d5 d6 d7

#define LAYOUT12X4( \
	a0, a1, a2, a3, a4, /**/ a5, a6, /**/ a7, a8, a9, aA, aB, \
	b0, b1, b2, b3, b4, /**/ b5, b6, /**/ b7, b8, b9, bA, bB, \
	c0, c1, c2, c3, c4, /**/ c5, c6, /**/ c7, c8, c9, cA, cB, \
	/*   */ d2, d3, d4, /**/ d5, d6, /**/ d7, d8, d9 \
	) \
	a0 a1 a2 a3 a4 /**/ a5 a6 /**/ a7 a8 a9 aA aB \
	b0 b1 b2 b3 b4 /**/ b5 b6 /**/ b7 b8 b9 bA bB \
	c0 c1 c2 c3 c4 /**/ c5 c6 /**/ c7 c8 c9 cA cB \
	      d2 d3 d4 /**/ d5 d6 /**/ d7 d8 d9

// Combo keys
#define CB_K 31
#define CB_H 32
#define CB_COMMA 33
#define CB_DOT 34

#define TECHNIKABLE
#define MOUSE_KEYS

#include "./base.keymap"

// vim:ft=c:fdm=indent
// https://zmk.dev/docs/codes/
