## config/boards/arm/technikable/Kconfig.board
```kconfig
# Technikable board configuration

# Copyright (c) 2021 Pete Johanson
# SPDX-License-Identifier: MIT

config BOARD_TECHNIKABLE
	bool "Technikable"
	depends on SOC_NRF52840_QIAA
```

## config/boards/arm/technikable/Kconfig.defconfig
```kconfig
# Copyright (c) 2020 Pete Johanson
# SPDX-License-Identifier: MIT

if BOARD_TECHNIKABLE

config BOARD
	default "technikable"

config ZMK_KEYBOARD_NAME
	default "Technikable"

if USB

config USB_NRFX
	default y

config USB_DEVICE_STACK
	default y

endif # USB

config BT_CTLR
	default BT

config ZMK_BLE
	default y

config ZMK_USB
	default y

endif # BOARD_TECHNIKABLE
```

## config/west.yml
```yaml
# https://github.com/zmkfirmware/unified-zmk-config-template/blob/main/config/west.yml
manifest:
  remotes:
    - name: zmkfirmware
      url-base: https://github.com/zmkfirmware
    - name: petejohanson
      url-base: https://github.com/petejohanson
  projects:
    # https://github.com/zmkfirmware/zmk/pull/2027
    # https://github.com/petejohanson/zmk/tree/feat/pointers-move-scroll
    - name: zmk
      remote: petejohanson
      revision: feat/pointers-move-scroll
      import: app/west.yml
    # - name: zmk
    #   remote: zmkfirmware
    #   revision: main
    #   import: app/west.yml
  self:
    path: config
```
